## boards/riscv/blackparrot/Kconfig.board
```kconfig
# SPDX-License-Identifier: Apache-2.0

config BOARD_BLACKPARROT
	bool "blackparrot target"
	# depends on SOC_BLACKPARROT
```

## boards/riscv/blackparrot/Kconfig.defconfig
```kconfig
# SPDX-License-Identifier: Apache-2.0

if BOARD_BLACKPARROT

config BOARD
	default "blackparrot"

endif
```

## boards/riscv/blackparrot/blackparrot_defconfig
```kconfig
# SPDX-License-Identifier: Apache-2.0

#CONFIG_SOC_SERIES_RISCV64_MIV=y
#CONFIG_SOC_RISCV32_MIV=y
#CONFIG_BOARD_M2GL025_MIV=y
#CONFIG_CONSOLE=y
#CONFIG_SERIAL=y
#CONFIG_UART_MIV=y
#CONFIG_UART_CONSOLE=y
#CONFIG_PLIC=n
#CONFIG_RISCV_MACHINE_TIMER=y
#CONFIG_GPIO=n
#CONFIG_XIP=y

# Workaround for incorect SYS_CLOCK_HW_CYCLES_PER_SEC
#CONFIG_SYS_CLOCK_TICKS_PER_SEC=100

CONFIG_SOC_SERIES_RISCV_BLACKPARROT=y
#CONFIG_SOC_RISCV_BLACKPARROT=y
#CONFIG_BOARD_BLACKPARROT=y

CONFIG_PRINTK=y

CONFIG_CONSOLE=n
CONFIG_UART_CONSOLE=n


CONFIG_SERIAL=y
#CONFIG_UART_NS16550=y
CONFIG_UART_XLNX_UARTLITE=y
#CONFIG_UART_INTERRUPT_DRIVEN=y
#CONFIG_UART_NS16550_ACCESS_WORD_ONLY=y


CONFIG_RISCV_MACHINE_TIMER=y
CONFIG_STACK_SENTINEL=y
CONFIG_XIP=n
```

## drivers/ethernet/Kconfig.xlnx_axiemac
```kconfig
DT_COMPAT_XLNX_GEM := xlnx,axiemac

menuconfig ETH_XLNX_AXIEMAC
	bool "Xilinx AXI Ethernet driver"
	default $(dt_compat_enabled,$(DT_COMPAT_XLNX_AXIEMAC))
	depends on SOC_SERIES_RISCV_BLACKPARROT
	help
	  Enable Xilinx axi Ethernet driver.
```

## soc/riscv/riscv-privilege/blackparrot/Kconfig.defconfig.series
```kconfig
# Copyright (c) 2020 Cobham Gaisler AB
# SPDX-License-Identifier: Apache-2.0

if SOC_SERIES_RISCV_BLACKPARROT

config SOC_SERIES
	default "blackparrot"

config SYS_CLOCK_HW_CYCLES_PER_SEC
	default 10000000
  

config RISCV_SOC_INTERRUPT_INIT
	default y

config RISCV_HAS_CPU_IDLE
	default y

config RISCV_HAS_PLIC
	default n

config 2ND_LVL_ISR_TBL_OFFSET
	default 12

config 2ND_LVL_INTR_00_OFFSET
	default 11

config MAX_IRQ_PER_AGGREGATOR
	default 52

config NUM_IRQS
	default 64

config COMPRESSED_ISA
	default n
  
config FPU
  default y
  
config CPU_HAS_FPU_DOUBLE_PRECISION
  default y
  
config RISCV_GENERIC_TOOLCHAIN
  default n
  


endif
```

## soc/riscv/riscv-privilege/blackparrot/Kconfig.soc
```kconfig
# Copyright (c) 2020 Cobham Gaisler AB
# SPDX-License-Identifier: Apache-2.0

choice
	prompt "BlackParrot RISC-V Board"
	depends on SOC_SERIES_RISCV_BLACKPARROT

config SOC_RISCV_BLACKPARROT
	bool "BlackParrot RISC-V Board"
	select ATOMIC_OPERATIONS_BUILTIN
	select INCLUDE_RESET_VECTOR

endchoice
```
